## config/west.yml
```yaml
manifest:
  remotes:
    - name: zmkfirmware
      url-base: https://github.com/zmkfirmware
    - name: stephen
      url-base: https://github.com/stephen
  projects:
    - name: zmk
      remote: stephen
      revision: stephen/split-encoder
      import: app/west.yml
  self:
    path: config

#manifest:
#  remotes:
#    - name: zmkfirmware
#      url-base: https://github.com/zmkfirmware
#  projects:
#    - name: zmk
#      remote: zmkfirmware
#      revision: main
#      import: app/west.yml
#  self:
#    path: config
```
